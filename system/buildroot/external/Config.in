## system/buildroot/external/package/r76s-edge-agent/Config.in
```kconfig
config BR2_PACKAGE_R76S_EDGE_AGENT
	bool "r76s-edge-agent"
	help
	  读取 /proc/uptime 并输出一行 JSON 的学习程序。
	  安装到 /usr/bin/edge-agent，BusyBox/SysV 启动时执行一次。
```

## system/buildroot/r76s_lab_defconfig
```kconfig
# 通用 AArch64 用户空间实验，不含 R76S 启动组件。
BR2_aarch64=y
BR2_TOOLCHAIN_BUILDROOT_GLIBC=y
BR2_KERNEL_HEADERS_6_1=y
BR2_TOOLCHAIN_BUILDROOT_CXX=y
BR2_INIT_BUSYBOX=y
BR2_PACKAGE_BUSYBOX=y
BR2_PACKAGE_DROPBEAR=y
# 相对现有 make -C work/buildroot 使用的 Buildroot 源码目录。
BR2_ROOTFS_OVERLAY="../../system/buildroot/rootfs-overlay"
BR2_TARGET_ROOTFS_EXT2=y
BR2_TARGET_ROOTFS_EXT2_4=y
BR2_TARGET_ROOTFS_EXT2_SIZE="128M"
# BR2_TARGET_ROOTFS_TAR is not set
# BR2_LINUX_KERNEL is not set
# BR2_TARGET_UBOOT is not set
# BR2_PACKAGE_PYTHON3 is not set
# BR2_PACKAGE_DOCKER_ENGINE is not set
# BR2_PACKAGE_XORG7 is not set
```
